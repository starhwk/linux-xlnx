## Documentation/devicetree/bindings/dma/xilinx/xlnx,zynqmp-dpdma.txt
```
Device-Tree bindings for Xilinx ZynqMP DisplayPort DMA engine

The ZynqMP DisplayPort subsystem handles DMA channel buffer management,
blending, and audio mixing. The DisplayPort subsystem receives display
and audio frames from DPDMA and transmits output to the DisplayPort IP core.

Required properties:
 - compatible: Should be "xlnx,zynqmp-dpdma".
 - reg: Base address and size of the IP core.
 - interrupts: Interrupt number.
 - interrupts-parent: phandle for interrupt controller.
 - clocks: phandle for AXI clock
 - clock-names: The identification string, "axi_clk", is always required.
 - #dma-channels: Should be <6>.
 - #dma-cells: Should be <1> for channel ID. Please see "dmas" in "DMA client"
 section below.

Example:

	dma-controller: dma-controller@43c10000 {
		compatible = "xlnx,zynqmp-dpdma";
		reg = <0x43c10000 0x1000>;
		interrupts = <0 54 4>;
		interrupt-parent = <&intc>;
		clocks = <&clkc 16>;
		clock-names = "axi_clk";

		dma-channels = <6>;
		#dma-cells = <1>;
	};

* DMA client

Required properties:
- dmas: a list of <[DPDMA device phandle] [Channel ID]> pairs. "Channel ID"
  is defined as video0 = 0, video1 = 1, video2 = 2, graphics = 3, audio0 = 4,
  and audio1 = 5.

Example:

	zynqmp-display@fd4a0000 {
		compatible = "xlnx,zynqmp-dpsub-1.7";
		reg = <0x0 0xfd4a0000 0x0 0x1000>,
		      <0x0 0xfd4aa000 0x0 0x1000>,
		      <0x0 0xfd4ab000 0x0 0x1000>,
		      <0x0 0xfd4ac000 0x0 0x1000>;

		...

		dma-names = "vid0", "vid1", "vid2", "gfx0";
		dmas = <&dma-controller 0>,
		       <&dma-controller 1>,
		       <&dma-controller 2>,
		       <&dma-controller 3>;
		...
	};
```

## drivers/gpu/drm/xlnx/Kconfig
```kconfig
# TODO: define dependency clearly
config DRM_XLNX
	tristate "Xilinx DRM KMS Driver"
	depends on DRM && OF
	select DRM_KMS_HELPER
	select DRM_KMS_CMA_HELPER
	select DRM_GEM_CMA_HELPER
	help
	  Xilinx DRM KMS driver.

config DRM_XLNX_BRIDGE
	tristate "Xilinx DRM KMS bridge"
	depends on DRM_XLNX
	help
	  Xilinx DRM KMS bridge.

config DRM_ZYNQMP_DPSUB
	tristate "ZynqMP DP Subsystem Driver"
	depends on ARCH_ZYNQMP && OF && DRM_XILINX && COMMON_CLK
	select XILINX_DPDMA
	select PHY_XILINX_ZYNQMP
	help
	  DRM KMS driver for ZynqMP DP Subsystem controller.

config DRM_ZYNQMP_DISP_DEBUG_FS
	bool "Xilinx DRM DPSUB debugfs"
	depends on DEBUG_FS && DRM_ZYNQMP_DPSUB
	select DRM_ZYNQMP_DP_DEBUG_FS
	help
	  Enable the debugfs code for DP Sub driver. The debugfs code
	  enables debugging or testing related features. It exposes some
	  low level controls to the user space to help testing automation,
	  as well as can enable additional diagnostic or statistical
	  information.

config DRM_ZYNQMP_DP_DEBUG_FS
	bool "Xilinx DRM DP debugfs"
	depends on DEBUG_FS && DRM_ZYNQMP_DPSUB
	help
	  Enable the debugfs code for DP driver. The debugfs code
	  enables debugging or testing related features. It exposes some
	  low level controls to the user space to help testing automation,
	  as well as can enable additional diagnostic or statistical
	  information.
```
